## src/arch/ppc64/Kconfig
```kconfig
config ARCH_PPC64
	bool

if ARCH_PPC64

config PPC64_ARCH
	string

config ARCH_BOOTBLOCK_PPC64
	bool
	default n

config ARCH_VERSTAGE_PPC64
	bool
	default n

config ARCH_ROMSTAGE_PPC64
	bool
	default n

config ARCH_RAMSTAGE_PPC64
	bool
	default n

endif # if ARCH_PPC64
```

## src/mainboard/emulation/qemu-powernv8/Kconfig
```kconfig
## SPDX-License-Identifier: GPL-2.0-only

# To execute, do:
# qemu-system-??

if BOARD_EMULATION_QEMU_POWERNV8

config BOARD_SPECIFIC_OPTIONS
	def_bool y
	select SOC_IBM_TURISMO
	select BOARD_ROMSIZE_KB_4096
	select ARCH_BOOTBLOCK_PPC64
	select ARCH_VERSTAGE_PPC64
	select ARCH_ROMSTAGE_PPC64
	select ARCH_RAMSTAGE_PPC64
	select HAVE_UART_SPECIAL
	select BOOT_DEVICE_NOT_SPI_FLASH
	select MISSING_BOARD_RESET

config MAINBOARD_DIR
	string
	default "emulation/qemu-powernv8"

config MAINBOARD_PART_NUMBER
	string
	default "QEMU POWERNV8"

config MAX_CPUS
	int
	default 1

config MAINBOARD_VENDOR
	string
	default "QEMU"

config DRAM_SIZE_MB
	int
	default 32768

endif #  BOARD_EMULATION_QEMU_POWERNV8
```

## src/mainboard/emulation/qemu-powernv9/Kconfig
```kconfig
## SPDX-License-Identifier: GPL-2.0-only

# To execute, do:
# qemu-system-??

if BOARD_EMULATION_QEMU_POWERNV9

config BOARD_SPECIFIC_OPTIONS
	def_bool y
	select SOC_IBM_NIMBUS
	select BOARD_ROMSIZE_KB_65536
	select ARCH_BOOTBLOCK_PPC64
	select ARCH_VERSTAGE_PPC64
	select ARCH_ROMSTAGE_PPC64
	select ARCH_RAMSTAGE_PPC64
	select BOOT_DEVICE_MEMORY_MAPPED
	select BOOT_DEVICE_NOT_SPI_FLASH
	select MISSING_BOARD_RESET

config MAINBOARD_DIR
	string
	default "emulation/qemu-powernv9"

config MAINBOARD_PART_NUMBER
	string
	default "QEMU POWERNV9"

config MAX_CPUS
	int
	default 1

config MAINBOARD_VENDOR
	string
	default "QEMU"

config DRAM_SIZE_MB
	int
	default 32768

endif #  BOARD_EMULATION_QEMU_POWERNV9
```

## src/mainboard/rcs/Kconfig
```kconfig
if VENDOR_RAPTORCS

choice
	prompt "Mainboard model"

source "src/mainboard/rcs/*/Kconfig.name"

endchoice

source "src/mainboard/rcs/*/Kconfig"

config MAINBOARD_VENDOR
	string "Mainboard Vendor"
	default "Raptor Computing Systems"

endif # VENDOR_RAPTORCS
```

## src/mainboard/rcs/talosii/Kconfig
```kconfig
config BOARD_RAPTORCS_TALOSII_COMMON
	def_bool n

if BOARD_RAPTORCS_TALOSII_COMMON

config BOARD_SPECIFIC_OPTIONS
	def_bool y
	select BOARD_ROMSIZE_KB_65536
	select SOC_IBM_NIMBUS
	select MISSING_BOARD_RESET
	select BOOT_DEVICE_MEMORY_MAPPED
	select BOOT_DEVICE_SPI_FLASH
	# select BOOT_DEVICE_NOT_SPI_FLASH

config MAINBOARD_DIR
	string
	default "rcs/talosii"

config MAINBOARD_VENDOR
	string
	default "Raptor Computing Systems"

config MAINBOARD_PART_NUMBER
	string
	default "Talos II"

endif # BOARD_RAPTORCS_TALOSII_COMMON
```

## src/mainboard/rcs/talosii/Kconfig.name
```kconfig
comment "Talos II"

config BOARD_RAPTORCS_TALOSII
	bool "-> Talos II"
	select BOARD_RAPTORCS_TALOSII_COMMON
```

## src/soc/ibm/power8/Kconfig
```kconfig
## SPDX-License-Identifier: GPL-2.0-only

config SOC_IBM_POWER8
	bool
	default n
	select ARCH_PPC64
	select ARCH_BOOTBLOCK_PPC64
	select ARCH_VERSTAGE_PPC64
	select ARCH_ROMSTAGE_PPC64
	select ARCH_RAMSTAGE_PPC64
	select NO_MONOTONIC_TIMER

if SOC_IBM_POWER8

config MEMLAYOUT_LD_FILE
	string
	default "src/soc/ibm/power8/memlayout.ld"

config PPC64_ARCH
	string
	default "power8"

endif # SOC_IBM_POWER8
```

## src/soc/ibm/power9/Kconfig
```kconfig
config SOC_IBM_POWER9
	bool
	default n
	select ARCH_PPC64
	select PPC64_USE_ARCH_TIMER
	select ARCH_BOOTBLOCK_PPC64
	select ARCH_VERSTAGE_PPC64
	select ARCH_ROMSTAGE_PPC64
	select ARCH_RAMSTAGE_PPC64

if SOC_IBM_POWER9

config MEMLAYOUT_LD_FILE
	string
	default "src/soc/ibm/power9/memlayout.ld"

config PPC64_ARCH
	string
	default "power9"

endif # SOC_IBM_POWER9
```
